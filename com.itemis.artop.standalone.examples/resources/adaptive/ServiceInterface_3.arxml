AUTOSAR XML (schema 00048)
package /Pack1
  service interface ServiceInterface3: is-service=true
