AUTOSAR XML (schema 00048)
package /Pack1
  service interface ServiceInterface1: is-service=true
