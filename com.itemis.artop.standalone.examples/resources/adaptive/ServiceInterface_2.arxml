AUTOSAR XML (schema 00048)
package /Pack1
  service interface ServiceInterface2: is-service=true
