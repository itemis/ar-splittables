AUTOSAR XML (schema 00048)
package /Pack1
  adaptive application sw component type SWC1
    require port RPortPrototype3: required-interface=ServiceInterface3
