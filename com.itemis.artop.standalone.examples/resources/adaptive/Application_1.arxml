AUTOSAR XML (schema 00048)
package /Pack1
  adaptive application sw component type SWC1
    require port RPortPrototype1: required-interface=ServiceInterface1
